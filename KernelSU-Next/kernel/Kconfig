## KernelSU-Next/kernel/Kconfig
```kconfig
menu "KernelSU"

config KSU
	tristate "KernelSU function support"
	default y
	help
	  Enable kernel-level root privileges on Android System.
	  Requires CONFIG_KPROBES for kernel hooking support.
	  To compile as a module, choose M here: the
	  module will be called kernelsu.

config KSU_DEBUG
	bool "KernelSU debug mode"
	depends on KSU
	default n
	help
	  Enable KernelSU debug mode.

config KSU_DISABLE_MANAGER
	bool "Disable KernelSU manager integration"
	depends on KSU
	default n
	help
	  Disable manager APK detection and manager-specific handling.
	  Root will be used in place of manager-only functionality.

config KSU_DISABLE_POLICY
	bool "Disable KernelSU policy profiles"
	depends on KSU
	default n
	help
	  Disable per-app root/non-root profile customization.
	  Escalation will always use the default full root profile, and
	  non-root handling will follow the global umount policy only.

config KSU_ALLOWLIST_WORKAROUND
	bool "KernelSU allowlist workaround"
	depends on KSU
	default n
	help
	  Enable workaround for broken allowlist save

# For easier extern ifdef handling
config KSU_MANUAL_HOOK
	bool "KernelSU manual hook mode."
	depends on KSU && KSU != m
	default y if !KPROBES
	default n
	help
	  Enable manual hook support.

choice
	prompt "KernelSU dynamic hook mode"
	depends on KSU && !KSU_MANUAL_HOOK
	default KSU_KPROBES_HOOK

config KSU_KPROBES_HOOK
	bool "KernelSU tracepoint+kretprobe hook"
	depends on KRETPROBES && KPROBES && HAVE_SYSCALL_TRACEPOINTS
	help
	  Enable KPROBES, KRETPROBES and TRACEPOINT hook for KernelSU core.
	  This should not be used on kernel below 5.10.

config KSU_SYSCALL_TABLE_HOOK
	bool "KernelSU syscall table patching hook"
	depends on ARM64 || X86_64
	help
	  Patch sys_call_table entries directly to hook syscalls without
	  kprobes or tracepoints. Intended for non-GKI kernels where kprobes
	  are unavailable or non-functional.
	  Requires kernel >= 4.17 (pt_regs-based syscall ABI).

endchoice

menu "KernelSU - SUSFS"

config KSU_SUSFS
	bool "KernelSU addon - SUSFS"
	depends on KSU && THREAD_INFO_IN_TASK
	default y
	help
	  Enable SuSFS v2 support for this non-GKI kernel.

config KSU_SUSFS_SUS_PATH
	bool "Hide suspicious paths"
	depends on KSU_SUSFS
	default y
	help
	  Hide user-defined paths from supported filesystem interfaces.

config KSU_SUSFS_SUS_MOUNT
	bool "Hide suspicious mounts"
	depends on KSU_SUSFS
	default y
	help
	  Hide user-defined mount paths from mount information interfaces.

config KSU_SUSFS_SUS_KSTAT
	bool "Spoof suspicious kstat"
	depends on KSU_SUSFS
	default y
	help
	  Spoof metadata for user-defined files and directories.

config KSU_SUSFS_TRY_UMOUNT
	bool "Use SuSFS try_umount helper (unsupported by this 4.14 port)"
	depends on KSU_SUSFS
	default n
	help
	  Leave disabled: the vendored SuSFS v2.3.0 4.14 port does not provide
	  susfs_try_umount() or susfs_add_try_umount().

config KSU_SUSFS_SPOOF_UNAME
	bool "Spoof uname"
	depends on KSU_SUSFS
	default y
	help
	  Allow userspace to configure the uname strings returned by the kernel.

config KSU_SUSFS_ENABLE_LOG
	bool "Enable SuSFS kernel logging"
	depends on KSU_SUSFS
	default y

config KSU_SUSFS_HIDE_KSU_SUSFS_SYMBOLS
	bool "Hide KernelSU and SuSFS symbols from kallsyms"
	depends on KSU_SUSFS
	default y

config KSU_SUSFS_SPOOF_CMDLINE_OR_BOOTCONFIG
	bool "Spoof /proc/cmdline or /proc/bootconfig"
	depends on KSU_SUSFS
	default y

config KSU_SUSFS_OPEN_REDIRECT
	bool "Redirect selected open paths"
	depends on KSU_SUSFS
	default y

config KSU_SUSFS_SUS_MAP
	bool "Hide selected mappings from proc maps interfaces"
	depends on KSU_SUSFS
	default y

config KSU_SUSFS_SUS_MEMFD
	bool "Hide or spoof suspicious memfd names (unsupported by this 4.14 port)"
	depends on KSU_SUSFS
	default n
	help
	  Leave disabled: this 4.14 SuSFS port does not provide susfs_add_sus_memfd().

endmenu

endmenu
```
